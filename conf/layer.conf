## conf/layer.conf
```bitbake
# reference for this file came from meta-zynq and meta-ti

# add this layer to bbpath
BBPATH .= ":${LAYERDIR}"

# Add recipes to bbfiles
BBFILES += "${LAYERDIR}/recipes-*/*/*.bb ${LAYERDIR}/recipes-*/*/*.bbappend"
# note to phil -- can't we do .bb* or [append]^?

# my guess is this is used on variable_appends (like bbfile_pattern)
BBFILE_COLLECTIONS += "h8-layer"

BBFILE_PATTERN_h8-layer := "^${LAYERDIR}/"

# priority for recipes from this layer
# oe-core is 5, meta-oe is 6
# phil used 6 for zynq, ti used 10

BBFILE_PRIORITY_h8-layer = "7"
```

## conf/machine/minimed-h8.conf
```bitbake
#@TYPE: Machine
#@NAME: Hitachi H8 on a minimed insulin pump
#@DESCRIPTION: see bewest/insulaudit on github

# I think we want to be the preferred provider for the kernel
# since none of the others will eve know about the proc
PREFERRED_PROVIDER_virtual/kernel = "linux-h8"

# pretty much all of this is a wild guess

IMAGE_FSTYPE += "tar.gz"
MACHINE_FEATURES = "vfat serial kernel26"

SERIAL_CONSOLE = "115200 ttyS2"

# I don't know how to set up a bootloader yet
# but both meta-ti and meta-zynq do something like this
# UBOOT_MACHINE = "da850evm_config"
# UBOOT_ENTRYPOINT = "0xc0008000"
# UBOOT_LOADADDRESS = "0xc0008000"
```
